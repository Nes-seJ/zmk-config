## config/boards/shields/tubetest/Kconfig.shield
```kconfig
config SHIELD_TUBETEST_LEFT
	def_bool $(shields_list_contains,tubetest_left)

config SHIELD_TUBETEST_RIGHT
	def_bool $(shields_list_contains,tubetest_right)
```
